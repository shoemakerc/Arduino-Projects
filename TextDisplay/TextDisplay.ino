/*
   TextDisplay
   By: Sam McHugh and Chris Shoemaker
   Last updated on: 6/30/2016
   Drives an Adafruit RGB LED Matrix panel
   Displays text, image bitmaps, and shapes in different colors
*/

#include <Adafruit_GFX.h>   // Core graphics library
#include <RGBmatrixPanel.h> // Hardware-specific library
#include <Fonts\FreeSans9pt7b.h> // Font library
#include <Fonts\FreeSans12pt7b.h>
#include <Fonts\TomThumb.h>

// This is coded for a Mega implementation
#if defined(__AVR_ATmega1280__) || defined(__AVR_ATmega2560__)
#else
setoffalarm now
#endif

// Comment this define out to use 16-line panel
#define Use32linePanel 1

// These are the pins being used
#define CLK 11  // MUST be on PORTB! (Use pin 11 on Mega)
#if Use32linePanel
#define LAT 10
#else
#define LAT A3
#endif
#define OE  9   // Output Enable
#define A   A0
#define B   A1
#define C   A2
#define D   A3
#define buffer_rate 5
#define screen_up_time 8
// Last parameter = 'true' enables double-buffering, for flicker-free,
// buttery smooth animation.  Note that NOTHING WILL SHOW ON THE DISPLAY
// until the first call to swapBuffers().  This is normal.

#ifdef Use32linePanel
// Constuctor for 64x32 panel
RGBmatrixPanel matrix(A, B, C, D, CLK, LAT, OE, true, 64);
#else
// Constuctor for 32x16 panel
RGBmatrixPanel matrix(A, B, C, CLK, LAT, OE, true);
#endif

int i = 0;
int j = 0;
int x = 0;
int prev = 0;
int curr = 0;

// Converted bitmap character arrays (created with http://javl.github.io/image2cpp/)
const unsigned char PROGMEM myBitmap1 [] = {0x00, 0x00, 0x00, 0x00, 0x00, 0x00, 0x00, 0x00, 0x00, 0x00, 0x00, 0x00, 0x00, 0x00, 0x00, 0x00,
                                            0x00, 0x00, 0x00, 0x00, 0x00, 0x00, 0x00, 0x00, 0x00, 0x00, 0x00, 0x00, 0x00, 0x00, 0x00, 0x00,
                                            0xff, 0xff, 0xff, 0xff, 0xff, 0xff, 0xff, 0xff, 0xff, 0xff, 0xff, 0xff, 0xff, 0xff, 0xff, 0xff,
                                            0x80, 0x00, 0x00, 0x00, 0x00, 0x00, 0x00, 0x03, 0x80, 0x00, 0x00, 0x00, 0x00, 0x00, 0x00, 0x03,
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                                            0x00, 0x00, 0x00, 0x00, 0x00, 0x00, 0x00, 0x00, 0x00, 0x00, 0x00, 0x00, 0x00, 0x00, 0x00, 0x00,
                                           };
const unsigned char PROGMEM myBitmap2 [] = {0x00, 0x00, 0x00, 0x00, 0x7f, 0x00, 0x00, 0x00, 0x00, 0x00, 0x00, 0x00, 0x7f, 0x80, 0x00, 0x00,
                                            0x00, 0x00, 0x00, 0x00, 0xff, 0x80, 0x00, 0x00, 0x00, 0x00, 0x00, 0x00, 0xff, 0x80, 0x3e, 0x00,
                                            0x00, 0x00, 0x00, 0x00, 0x7f, 0x00, 0x3e, 0x00, 0x00, 0x00, 0x00, 0x00, 0x00, 0x00, 0x3e, 0x00,
                                            0x00, 0x00, 0x00, 0x00, 0x00, 0x00, 0x7e, 0x00, 0x00, 0x00, 0x00, 0x00, 0x00, 0x03, 0xff, 0xfe,
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                                            0x01, 0xff, 0xf8, 0x00, 0x00, 0x00, 0x00, 0x00, 0x00, 0x00, 0x00, 0x00, 0x00, 0x00, 0x00, 0x00,
                                           };
const unsigned char PROGMEM myBitmap3 [] = {0x00, 0x1f, 0xf0, 0x00, 0x00, 0x1f, 0xf8, 0x00, 0x00, 0xff, 0xff, 0x00, 0x00, 0xff, 0xff, 0x04,
                                            0x03, 0xff, 0xff, 0xc0, 0x03, 0xff, 0xff, 0xc0, 0x0f, 0xff, 0xff, 0xf0, 0x0f, 0xff, 0xff, 0xf0,
                                            0x1f, 0xe0, 0x0f, 0xf8, 0x1f, 0xf0, 0x0f, 0xf8, 0x3f, 0x80, 0x01, 0xfc, 0x3f, 0x80, 0x01, 0xfc,
                                            0x7f, 0x00, 0x00, 0xfe, 0x7f, 0x00, 0x00, 0xfe, 0x7e, 0x00, 0x00, 0x7f, 0xfc, 0x00, 0x00, 0x7e,
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                                            0x61, 0x99, 0xdd, 0xe6, 0x30, 0xe1, 0x9e, 0xee, 0x61, 0xd8, 0xdf, 0x83, 0xe3, 0xf9, 0x8e, 0x7c,
                                           };
const unsigned char PROGMEM jimi [] = {0xff, 0x80, 0x00, 0x3f, 0xfc, 0x00, 0x00, 0x1f, 0xf8, 0x00, 0x00, 0x1f, 0xe0, 0x00, 0x00, 0x07,
                                       0xe0, 0x00, 0x00, 0x0f, 0xe0, 0x00, 0x00, 0x07, 0xf0, 0x00, 0x00, 0x03, 0xc0, 0x00, 0x00, 0x07,
                                       0xc0, 0x00, 0x00, 0x01, 0xc0, 0x1d, 0xe0, 0x00, 0xc0, 0x1f, 0xd0, 0x00, 0x80, 0x11, 0x80, 0x00,
                                       0x80, 0x39, 0xb0, 0x00, 0x00, 0x03, 0xc0, 0x01, 0x40, 0x3f, 0xa0, 0x01, 0xc0, 0x7f, 0x78, 0x01,
                                       0x80, 0x7c, 0x38, 0x01, 0x80, 0x3f, 0x90, 0x01, 0xe0, 0x1f, 0x90, 0x01, 0xe0, 0x1c, 0x00, 0x01,
                                       0xf0, 0x37, 0x80, 0x07, 0xf8, 0x34, 0x00, 0x07, 0xf8, 0x00, 0x00, 0x1c, 0xfe, 0x07, 0x80, 0x09,
                                       0xff, 0x04, 0x00, 0x00, 0xfe, 0x20, 0x00, 0x00, 0xfb, 0x38, 0x00, 0x00, 0xfa, 0x38, 0x00, 0x80,
                                       0xf1, 0xb8, 0x02, 0xc0, 0xf3, 0xfc, 0xc3, 0xe0, 0xf5, 0xf8, 0x01, 0xe0, 0xfc, 0xfc, 0x01, 0xe0,
                                      };
const unsigned char PROGMEM zuckerberg [] = {0x00, 0x00, 0x00, 0x00, 0x00, 0x00, 0x00, 0x00, 0x00, 0x00, 0x00, 0x00, 0x00, 0x00, 0x00, 0x00,
                                             0x00, 0x00, 0x00, 0x00, 0x00, 0x18, 0x00, 0x00, 0x00, 0x3f, 0xf8, 0x00, 0x00, 0x3f, 0xff, 0x00,
                                             0x00, 0x3f, 0xff, 0x00, 0x00, 0x3f, 0xff, 0x00, 0x00, 0x3f, 0xff, 0x00, 0x00, 0x3f, 0xff, 0x00,
                                             0x00, 0x3f, 0xff, 0x00, 0x00, 0x1f, 0xf2, 0x00, 0x00, 0x3b, 0xf7, 0x00, 0x00, 0x01, 0xf8, 0x00,
                                             0x00, 0x5f, 0xfe, 0x80, 0x00, 0x7f, 0x7f, 0xb0, 0x18, 0x7f, 0x7f, 0xb0, 0x0c, 0x7f, 0x7f, 0xa0,
                                             0x02, 0x3f, 0xff, 0xa0, 0x00, 0x3e, 0xff, 0x20, 0x00, 0x7e, 0x0f, 0x80, 0x1e, 0x3f, 0xff, 0x00,
                                             0x3e, 0x1f, 0xff, 0x00, 0x3e, 0x1e, 0x8f, 0x00, 0x7f, 0x1f, 0xfe, 0x00, 0x3e, 0x1f, 0xfe, 0x00,
                                             0x3c, 0x0f, 0xbc, 0x00, 0x00, 0x0f, 0xfc, 0x00, 0x00, 0x07, 0xf8, 0x00, 0x00, 0x03, 0xf0, 0x00,
                                            };

void setup()
{
  // Setup host communication

  // Setup RGB LED Matrix
  matrix.begin();
  matrix.setTextWrap(false); // Allow text to run off right edge
  matrix.setTextSize(1);

  // remove serial port debugger when releasing
  Serial.begin(9600);
}

int textX   = matrix.width(),
    textY   = matrix.height() + 15;

void loop()
{
  unsigned long time_passed = millis();
  // Clear background
  matrix.fillScreen(0);
  matrix.setFont(0);

  //bitmap2();

  // Display different screens (in order listed below)
  if ((time_passed / 1000) % (9 * screen_up_time) <= screen_up_time) {
    curr = 1;
    bitmap(myBitmap1);
  } else if ((time_passed / 1000) % (9 * screen_up_time) > screen_up_time && (time_passed / 1000) % (9 * screen_up_time) <= 2 * screen_up_time) {
    curr = 2;
    bitmap(myBitmap2);
  } else if ((time_passed / 1000) % (9 * screen_up_time) > 2 * screen_up_time && (time_passed / 1000) % (9 * screen_up_time) <= 3 * screen_up_time) {
    curr = 3;
    bitmap(myBitmap3);
  } else if ((time_passed / 1000) % (9 * screen_up_time) > 3 * screen_up_time && (time_passed / 1000) % (9 * screen_up_time) <= 4 * screen_up_time) {
    bitmap2();
  } else if ((time_passed / 1000) % (9 * screen_up_time) > 4 * screen_up_time && (time_passed / 1000) % (9 * screen_up_time) <= 5 * screen_up_time) {
    displayScreen1();
  } else if ((time_passed / 1000) % (9 * screen_up_time) > 5 * screen_up_time && (time_passed / 1000) % (9 * screen_up_time) <= 6 * screen_up_time) {
    displayScreen2();
  } else if ((time_passed / 1000) % (9 * screen_up_time) > 6 * screen_up_time && (time_passed / 1000) % (9 * screen_up_time) <= 7 * screen_up_time) {
    lines();
  } else if ((time_passed / 1000) % (9 * screen_up_time) > 7 * screen_up_time && (time_passed / 1000) % (9 * screen_up_time) <= 8 * screen_up_time) {
    curr = 4;
    arrow();
  } else {
    curr = 5;
    logo(matrix.Color888(105, 105, 105));
  }

  matrix.swapBuffers(true);
  delay(buffer_rate);
}

void displayScreen1() {
  helloLine();
  yayLine();
}

void displayScreen2() {
  wootLine();
  lolLine();
}

// Displays the word "Hello, world!" horizontally-scrolling
void helloLine() {
  String displayMessage = "Hello, world!";
  int len = displayMessage.length() * 10;
  const GFXfont *pfont = &FreeSans9pt7b;
  matrix.setFont(pfont);
  matrix.setTextColor(matrix.Color888(150, 0, 0));
  matrix.setCursor(i, 16);
  if (textX < i) { // gives (horizontal) scrolling functionality
    i = -(len);
  }
  matrix.print(displayMessage);
  i++;
}

// Displays the word "Woot" vertically-scrolling
void wootLine() {
  String displayMessage = "Woot!";
  const GFXfont *pfont2 = &FreeSans12pt7b;
  matrix.setFont(pfont2);
  matrix.setCursor(4, j);
  matrix.setTextColor(matrix.Color888(255, 140  , 0));
  if (textY < j) { // gives (vertical) scrolling functionality
    j = 0;
  }
  matrix.print(displayMessage);
  j++;
}

// Displays the word "Yay"
void yayLine() {
  const GFXfont *pfont2 = &FreeSans12pt7b;
  matrix.setFont(pfont2);
  matrix.setCursor(15, 20);
  matrix.setTextColor(matrix.Color888(0, 0, 150));
  matrix.print("Yay");
}

// Displays the word "lol" in varying brightness levels
void lolLine() {
  const GFXfont *pfont = &FreeSans9pt7b;
  matrix.setFont(pfont);
  matrix.setCursor(35, 20);
  matrix.setTextColor(matrix.Color888(0, (10 * j) % 150, 0));
  matrix.print("lol");
}

// Draws a series of lines
void lines() {
  for (int ix = 0; ix <= 4; ix++) {
    matrix.drawLine(0, 0, 8 * ix, 32 - (8 * ix), 44 * (ix + 10));
  }
}

// Creates a horizontally-scrolling arrow
void arrow() {
  if (curr != prev) {
    x = 0;
  }
  matrix.fillRect(23 + x, 10, 20, 11, 255);
  matrix.fillTriangle(43 + x, 6, 43 + x, 24, 52 + x, 15 , 255);
  if (x > textX) { // gives scrolling functionality
    x = -textX;
  } else {
    x++;
  }
  prev = 4;
}

// Displays the Oculus logo horizontally-scrolling
void logo(int color) {
  if (curr != prev) {
    x = 0;
  }
  const GFXfont *pfont = &TomThumb;
  matrix.fillCircle(15 + x, 16, 6, color);
  matrix.fillCircle(30 + x, 16, 6, color);
  matrix.fillRect(15 + x, 10, 16, 13, color);
  matrix.fillCircle(17 + x, 16, 2, 0x0000);
  matrix.fillCircle(28 + x, 16, 2, 0x0000);
  matrix.fillRect(17 + x, 14, 11, 5, 0x0000);
  matrix.setCursor(6 + x, 24);
  matrix.setTextColor(color);
  matrix.print("Oculus");
  if (x > textX) { // gives scrolling functionality
    x = -textX;
  } else {
    x++;
  }
  prev = 5;
}

// Displays scrolling bitmap images of different logos
void bitmap(const uint8_t *bitmap_input) {
  if (curr != prev) {
    x = 0;
  }
  matrix.drawBitmap(x, 0, bitmap_input, 64, 32, matrix.Color888(218, 165, 32));
  if (x > textX) { // gives scrolling functionality
    x = -textX;
  } else {
    x++;
  }
  if (bitmap_input == myBitmap1) {
    prev = 1;
  } else if (bitmap_input == myBitmap2) {
    prev = 2;
  } else {
    prev = 3;
  }
}

// Displays static bitmap images of two faces (Jimi Hendrix + Mark Zuckerberg)
//void bitmap2() {
//  matrix.drawBitmap(0, 0, jimi, 32, 32, matrix.Color888(128, 0, 0), matrix.Color888(218, 112, 214), matrix.Color888(238,221,130));
//  matrix.drawBitmap(32, 0, zuckerberg, 32, 32, matrix.Color888(59, 89, 152), matrix.Color888(34, 139, 34), matrix.Color888(240, 128, 128));
//}

void bitmap2() {
  matrix.drawBitmap(0, 0, jimi, 32, 32, matrix.Color888(128, 0, 0));
  matrix.drawBitmap(32, 0, zuckerberg, 32, 32, matrix.Color888(59, 89, 152));
}

